/* Basado en: ESP8266 AWS IoT example by Evandro Luis Copercini
   Public Domain - 2017
   It connects to AWS IoT server then:
  - publishes " to the topic "outTopic" every two seconds
  - subscribes to the topic "inTopic", printing out any messages
*/

#define MSG_BUFFER_SIZE 200
#define MQTT_MAX_PACKET_SIZE 256 // Si no funciona, modificar el PubSubClient.h

#include <ESP8266WiFi.h>
#include <PubSubClient.h> //Get it from here: https://github .com/knolleary/pubsubclient
#include <NTPClient.h>
#include <WiFiUdp.h>
#include <Wire.h>
#include <RtcDS3231.h>
#include "ArduinoJson.h"


// CONNECTIONS:
// DS3231 SDA --> SDA
// DS3231 SCL --> SCL
// DS3231 VCC --> 3.3v or 5v
// DS3231 GND --> GND
// For ESP8266, I2C default to SDA = GPIO04 (D2) and SCL = GPIO05 (D1); but check with your specific board.
// Light Sensor In Analogic --> D7

/* convert and replace with your keys
  $ openssl x509 -in aaaaaaaaa-certificate.pem.crt -out certificates/cert.der -outform DER
  $ openssl rsa -in aaaaaaaaaa-private.pem.key -out certificates/private.der -outform DER
  $ xxd -i certificates
*/
unsigned char arduinoesp_3048_key[] = {
  0x30, 0x82, 0x04, 0xa3, 0x02, 0x01, 0x00, 0x02, 0x82, 0x01, 0x01, 0x00,
  0xbc, 0x21, 0x29, 0xc4, 0x40, 0xbe, 0xd8, 0xf6, 0x3b, 0xfe, 0xbe, 0xdc,
  0xe9, 0x9e, 0x54, 0x76, 0xb8, 0x84, 0x53, 0xf4, 0xae, 0xb5, 0x32, 0x47,
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  0x50, 0x86, 0x0c
};
unsigned int arduinoesp_3048_key_len = 1191;

unsigned char arduinoesp_3048_der[] = {
  0x30, 0x82, 0x03, 0x59, 0x30, 0x82, 0x02, 0x41, 0xa0, 0x03, 0x02, 0x01,
  0x02, 0x02, 0x14, 0x6c, 0xeb, 0x0c, 0x56, 0x61, 0x04, 0x81, 0x51, 0x51,
  0x4c, 0xcf, 0x1f, 0x83, 0xa1, 0x1e, 0xae, 0x44, 0x38, 0xf1, 0xc0, 0x30,
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  0xb1, 0x54, 0x42, 0x6f, 0x34, 0xa9, 0xea, 0x65, 0x4a
};
unsigned int arduinoesp_3048_der_len = 861;

unsigned char aws_root_ca_der[] = {
  0x30, 0x82, 0x03, 0x41, 0x30, 0x82, 0x02, 0x29, 0xa0, 0x03, 0x02, 0x01,
  0x02, 0x02, 0x13, 0x06, 0x6c, 0x9f, 0xcf, 0x99, 0xbf, 0x8c, 0x0a, 0x39,
  0xe2, 0xf0, 0x78, 0x8a, 0x43, 0xe6, 0x96, 0x36, 0x5b, 0xca, 0x30, 0x0d,
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  0x59, 0x33, 0xf8, 0xeb, 0xc4, 0x90, 0xbe, 0xf1, 0xb9
};
unsigned int aws_root_ca_der_len = 837;


// //////////////////////////////////////////////////////     CONSTANTS   //////////////////////////////////////////////////////

const char* AWS_endpoint = "a3ndp1z76itiwu-ats.iot.us-east-1.amazonaws.com"; //MQTT broker ip
const char* ssid = "Wifi@Home";
const char* password = "33056630";
// const int Pin_LightSensor = A0;  // Pin Light Sensor
// const int Pin_SensorMoisture  = D3;  // Pin Moisture Sensor
const int Pin_Led_StatusAlert  = BUILTIN_LED;

const int Pin_ReadAnalogSensor = A0;  // Pin Light Sensor
const int Pin_SensorMoisture_ON  = D5;  // Pin Moisture Sensor
const int Pin_LightSensor_ON = D6;  // Pin Light Sensor


// //////////////////////////////////////////////////////     VARIABLES   ////////////////////////////////////////////////////// 
// Sensors
int iReadAnalogSensor = 0;
int iSensorMoisture = 0;
int iSensor_Light = 0;

// Variables
int iPeriod = 60000;  //Time period for production
// int iPeriod = 3000; //Debug Time for test

float fVersion = 2.2;
String ThingID = "";
unsigned long lNow = 0;

// Objetos WIFI y NTPClient   ---------------------------------------------------------------------
WiFiUDP ntpUDP;
NTPClient timeClient(ntpUDP, "pool.ntp.org",  -3*3600); // Timezone -3 Buenos Aires

WiFiClientSecure espClient;
RtcDS3231<TwoWire> Rtc(Wire);


// //////////////////////////////////////////////////////     FUNCTIONS   //////////////////////////////////////////////////////

int ReadAnalogSensor(int iSensor_Port) {
  iReadAnalogSensor = 0;
/*  digitalWrite(Pin_SensorMoisture_ON, LOW); // OFF Pin Sensor
  digitalWrite(Pin_LightSensor_ON, LOW); // OFF Pin Sensor
    Serial.println("...............................................");
      Serial.print("Analog Read Port  xxx LOW  xxx "); Serial.println(iSensor_Port);
        digitalWrite(iSensor_Port, LOW); // OFF Pin Sensor
         delay(100);
         iReadAnalogSensor = analogRead(Pin_ReadAnalogSensor);
        Serial.print("Analog Read Data:"); Serial.println(iReadAnalogSensor);
  Serial.println("...............................................");
     Serial.print("Analog Read Port ---- HIGH ---:"); Serial.println(iSensor_Port);
*/
        digitalWrite(iSensor_Port, HIGH); // OFF Sensor
         delay(100);
         iReadAnalogSensor = analogRead(Pin_ReadAnalogSensor);
        digitalWrite(iSensor_Port, LOW); // OFF Sensor
//        Serial.print("Analog Read Data:"); Serial.println(iReadAnalogSensor);
//  Serial.println("...............................................");
   return iReadAnalogSensor;
}


void callback(char* topic, byte* payload, unsigned int length) {
  Serial.print("Message arrived [");
  Serial.print(topic);
  Serial.print("] ");
  for (int i = 0; i < length; i++)
    Serial.print((char)payload[i]);

// Switch on the LED if an 1 was received as first character
  if ((char)payload[0] == '1') {
    digitalWrite(Pin_Led_StatusAlert, LOW);   // Turn the LED on (Note that LOW is the voltage level
    // but actually the LED is on; this is because
    // it is active low on the ESP-01)
  } else {
    digitalWrite(Pin_Led_StatusAlert, HIGH);  // Turn the LED off by making the voltage HIGH
  }
  Serial.println();
}

PubSubClient client(AWS_endpoint, 8883, callback, espClient); //set  MQTT port number to 8883
long lastMsg = 0;
char msg[MSG_BUFFER_SIZE];
int value = 0;

void reconnect() {
  // Loop until we're reconnected
       while (!client.connected()) {
    Serial.print("Attempting MQTT connection...");
 //   Create a random client ID
    String clientId = "ESP8266Client-id-";
    clientId += String(random(0xffff), HEX);

    Serial.print("Client ID: ");
    Serial.println(clientId);
    ThingID = clientId;

    // Attempt to connect
   if (client.connect(clientId.c_str())) {
      Serial.println("connected");
      client.subscribe("iot/device/esp8266/in");
      Serial.println("Suscribe in Topic: iot/device/esp8266/in");


    } else {
      Serial.print("failed, rc=");
      Serial.print(client.state());
      Serial.println(" try again in 5 seconds");
      // Wait 5 seconds before retrying
      delay(5000);
   }
  }
}


// //////////////////////////////////////////////////////     SETUP   //////////////////////////////////////////////////////
void setup() {
  pinMode(Pin_Led_StatusAlert, OUTPUT);     // Initialize the BUILTIN_LED pin as an output
  pinMode(Pin_ReadAnalogSensor, INPUT);
  
  pinMode(Pin_SensorMoisture_ON, OUTPUT); // Initialize the Moisture Sensor as an Input
  pinMode(Pin_LightSensor_ON, OUTPUT); // Initialize the Moisture Sensor as an Input

  digitalWrite(Pin_SensorMoisture_ON, LOW); // OFF Pin Sensor
  digitalWrite(Pin_LightSensor_ON, LOW); // OFF Pin Sensor
  
  Serial.begin (115200);
  WiFi.begin(ssid, password);
  while (WiFi.status() != WL_CONNECTED) {
    delay(500);
    Serial.print(".");
  }
  espClient.setCertificate(arduinoesp_3048_der, arduinoesp_3048_der_len);
  espClient.setPrivateKey(arduinoesp_3048_key, arduinoesp_3048_key_len);
  espClient.setCACert(aws_root_ca_der, aws_root_ca_der_len);

  timeClient.begin();
   while(!timeClient.update()){
     timeClient.forceUpdate();
   }
  espClient.setX509Time(timeClient.getEpochTime());

  Serial.println("");
  Serial.println("WiFi connected");
  Serial.print("IP address: "); Serial.println(WiFi.localIP());

  Rtc.Begin();
  Rtc.SetDateTime(timeClient.getEpochTime()-946684800UL);  // Do udp NTP lookup, epoch time is unix time - subtract the 30 extra yrs (946684800UL) library expects 2000
  Rtc.Enable32kHzPin(false);
  Rtc.SetSquareWavePin(DS3231SquareWavePin_ModeNone);
  RtcDateTime now = Rtc.GetDateTime();

  Serial.print(" Tiempo de NTP:"); Serial.println(timeClient.getEpochTime());
  Serial.print(" Tiempo de Clock DS3231:");
  Serial.println(now);
  
  String hora = (String)now.Hour()+":"+(String)now.Minute()+":"+(String)now.Second();
  String dia = (String)now.Year()+"/"+(String)now.Month()+"/"+(String)now.Day();
  Serial.print(dia); Serial.println(hora);
 
  iSensor_Light = ReadAnalogSensor(Pin_LightSensor_ON); // print the sensor reading so you know its range
  Serial.print("Sensor de luz:");Serial.println(iSensor_Light);
  
  iSensorMoisture = ReadAnalogSensor(Pin_SensorMoisture_ON);
  Serial.print("Moisure Sensor: :");Serial.println(iSensorMoisture);
  Serial.println("-----------------------------------------------------------------------------------------------------------");
}



// //////////////////////////////////////////////////////     LOOP   //////////////////////////////////////////////////////
void loop() {
   if (!client.connected()) {
      reconnect();
    }
    client.loop(); // process incoming messages and maintain its connection to the server.
    
   lNow = millis();
  if (lNow - lastMsg > iPeriod) {
    lastMsg = lNow;
    ++value;
// Get Version
     Serial.print("Version :");Serial.println(fVersion);
     Serial.print("Buffer Size:");Serial.println(MSG_BUFFER_SIZE);
// Get day and time from RS3231
      RtcDateTime now = Rtc.GetDateTime();
      String dia = (String)now.Year()+"/"+(String)now.Month()+"/"+(String)now.Day();
      String hora = (String)now.Hour()+":"+(String)now.Minute()+":"+(String)now.Second();
      Serial.print("Time: "); Serial.print(dia);Serial.print(" , "); Serial.println(hora);
// Get temperature from RtcDS3231
      RtcTemperature  temp = Rtc.GetTemperature();
      Serial.print("Temperature:"); Serial.println(temp.AsFloatDegC());
      float temperatura = temp.AsFloatDegC();
// Get light sensor from Analog Light Sensor 593438
      iSensor_Light = ReadAnalogSensor(Pin_LightSensor_ON );
      Serial.print("Light Sensor :");Serial.println(iSensor_Light);

// Prints the condition of soil.  Dry, Wet or Perfect
      iSensorMoisture = ReadAnalogSensor(Pin_SensorMoisture_ON );
 /*   if (iSensorMoisture >= 1000) (Serial.print("Moisure Sensor: (soil too dry): "));
     else if ((iSensorMoisture <= 999) && (iSensorMoisture >=901)) (Serial.print("Moisure Sensor: (soil too dry): "));
     else if (iSensorMoisture <= 900) (Serial.print("Moisure Sensor: (soil is wet) :"));
    else;
 */   
    Serial.print("Moisture Sensor :");
    Serial.println(iSensorMoisture);

// Created Json data to publish 
  StaticJsonDocument<MSG_BUFFER_SIZE> JSONMessage;
    JSONMessage["@timestamp"] = timeClient.getEpochTime();
    JSONMessage["thing"] = ThingID;
    JSONMessage["sensor"] = "DS3231";
    JSONMessage["trx"] = value;
    JSONMessage["date"] = dia;
    JSONMessage["time"] = hora;
    JSONMessage["temperature"] = temperatura;
    JSONMessage["light"] = iSensor_Light;
    JSONMessage["moisture"] = iSensorMoisture;
    JSONMessage["version"] = fVersion;

    char json_string[MSG_BUFFER_SIZE];
    serializeJson(JSONMessage, json_string);

    snprintf (msg, MSG_BUFFER_SIZE, json_string );
    Serial.println("Publish message in Topic: iot/device/esp8266/out ");
    Serial.println(msg);
    client.publish("iot/device/esp8266/out" , msg);
    Serial.print("Heap: "); Serial.println(ESP.getFreeHeap()); //Low heap can cause problems
    Serial.println("--------------------------------------------------------------------------------");
  }
}
